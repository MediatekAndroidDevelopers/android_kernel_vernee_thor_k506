## drivers/input/fingerprint/Kconfig
```kconfig
#
#Fingerprint
#

config MTK_FINGERPRINT
	tristate "Mediatek Fingerprint"
	default n
	---help---
	Fingerprint mtk driver enable/disable in the kernel.
	Say Y here if you want to use mediatek fingerprint driver,
	fingerprint driver will support fingerprint function in REE,
	it supports FPC's 102x/104x device.
# Fingerprint sensor
config MTK_ET310
        bool "ET310 for MediaTek package"
        default n

config FINGERPRINT_BL229X
        bool "BL229X for MediaTek package"
        default n
```
